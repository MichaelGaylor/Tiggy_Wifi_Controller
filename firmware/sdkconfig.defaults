## firmware/sdkconfig.defaults
```kconfig
# WiFi CNC Controller - ESP-IDF Configuration Defaults
# Common defaults shared by all PlatformIO environments

# Dual-core operation
CONFIG_FREERTOS_UNICORE=n

# WiFi tuning for low-latency UDP
CONFIG_ESP_WIFI_STATIC_RX_BUFFER_NUM=10
CONFIG_ESP_WIFI_DYNAMIC_RX_BUFFER_NUM=32
CONFIG_ESP_WIFI_DYNAMIC_TX_BUFFER_NUM=32
CONFIG_ESP_WIFI_AMPDU_TX_ENABLED=y
CONFIG_ESP_WIFI_AMPDU_RX_ENABLED=y
CONFIG_ESP_WIFI_TX_BA_WIN=6
CONFIG_ESP_WIFI_RX_BA_WIN=6

# Ethernet (W5500 SPI module, optional)
CONFIG_ETH_ENABLED=y
CONFIG_ETH_USE_SPI_ETHERNET=y
CONFIG_ETH_SPI_ETHERNET_W5500=y

# LWIP tuning
CONFIG_LWIP_UDP_RECVMBOX_SIZE=16

# Task watchdog
CONFIG_ESP_TASK_WDT=y
CONFIG_ESP_TASK_WDT_TIMEOUT_S=5

# FreeRTOS tick rate 1kHz for 1ms resolution
CONFIG_FREERTOS_HZ=1000

# GPIO ISR in IRAM for fast response
CONFIG_GPIO_CTRL_FUNC_IN_IRAM=y

# Custom partition table
CONFIG_PARTITION_TABLE_CUSTOM=y
CONFIG_PARTITION_TABLE_CUSTOM_FILENAME="partitions.csv"

# Performance optimization
CONFIG_COMPILER_OPTIMIZATION_PERF=y

# Disable brownout detector (CNC power can be noisy)
CONFIG_ESP_BROWNOUT_DET=n

# HTTP server (captive portal)
CONFIG_HTTPD_MAX_REQ_HDR_LEN=2048

# Log level: Info (show startup and guard diagnostics on serial)
CONFIG_LOG_DEFAULT_LEVEL_WARN=y
CONFIG_LOG_DEFAULT_LEVEL=2
```

## firmware/sdkconfig.defaults.devkitc_octal
```kconfig
# WiFi CNC Controller - ESP-IDF Configuration Defaults
# ESP32-S3 DevKitC octal-memory variants (N16R8 / N8R8 class)

CONFIG_ESPTOOLPY_FLASHSIZE_16MB=y
CONFIG_SPIRAM_MODE_OCT=y
CONFIG_SPIRAM_TYPE_AUTO=y
CONFIG_SPIRAM_ALLOW_STACK_EXTERNAL_MEMORY=y
CONFIG_SPIRAM_SPEED_80M=y
CONFIG_SPIRAM_SPEED=80
CONFIG_SPIRAM_USE_MALLOC=y
CONFIG_SPIRAM_MALLOC_ALWAYSINTERNAL=4096
CONFIG_SPIRAM_TRY_ALLOCATE_WIFI_LWIP=y
CONFIG_SPIRAM_MALLOC_RESERVE_INTERNAL=0

# Dual-core operation
CONFIG_FREERTOS_UNICORE=n

# WiFi tuning for low-latency UDP
CONFIG_ESP_WIFI_STATIC_RX_BUFFER_NUM=10
CONFIG_ESP_WIFI_DYNAMIC_RX_BUFFER_NUM=32
CONFIG_ESP_WIFI_DYNAMIC_TX_BUFFER_NUM=32
CONFIG_ESP_WIFI_AMPDU_TX_ENABLED=y
CONFIG_ESP_WIFI_AMPDU_RX_ENABLED=y
CONFIG_ESP_WIFI_TX_BA_WIN=6
CONFIG_ESP_WIFI_RX_BA_WIN=6

# Ethernet (W5500 SPI module, optional)
CONFIG_ETH_ENABLED=y
CONFIG_ETH_USE_SPI_ETHERNET=y
CONFIG_ETH_SPI_ETHERNET_W5500=y

# LWIP tuning
CONFIG_LWIP_UDP_RECVMBOX_SIZE=16

# Task watchdog
CONFIG_ESP_TASK_WDT=y
CONFIG_ESP_TASK_WDT_TIMEOUT_S=5

# FreeRTOS tick rate 1kHz for 1ms resolution
CONFIG_FREERTOS_HZ=1000

# GPIO ISR in IRAM for fast response
CONFIG_GPIO_CTRL_FUNC_IN_IRAM=y

# Custom partition table
CONFIG_PARTITION_TABLE_CUSTOM=y
CONFIG_PARTITION_TABLE_CUSTOM_FILENAME="partitions.csv"

# Performance optimization
CONFIG_COMPILER_OPTIMIZATION_PERF=y

# Disable brownout detector (CNC power can be noisy)
CONFIG_ESP_BROWNOUT_DET=n

# HTTP server (captive portal)
CONFIG_HTTPD_MAX_REQ_HDR_LEN=2048

# Log level: Info (show startup and guard diagnostics on serial)
CONFIG_LOG_DEFAULT_LEVEL_WARN=y
CONFIG_LOG_DEFAULT_LEVEL=2
```
